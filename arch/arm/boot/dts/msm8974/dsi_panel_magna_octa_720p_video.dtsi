/* Copyright (c) 2012, Samsung Electronics Corporation. All rights reserved.
 *
 * This program is free software; you can redistribute it and/or modify
 * it under the terms of the GNU General Public License version 2 and
 * only version 2 as published by the Free Software Foundation.
 *
 * This program is distributed in the hope that it will be useful,
 * but WITHOUT ANY WARRANTY; without even the implied warranty of
 * MERCHANTABILITY or FITNESS FOR A PARTICULAR PURPOSE.  See the
 * GNU General Public License for more details.
 */

&mdss_mdp {

	dsi_magna_720p_fresco: mdss_dsi_magna_octa_720p_video {
		qcom,mdss-dsi-panel-name = "samsung,mdss-amoled-dsi-panel";
		label = "samsung amoled 720p video mode dsi EA8061 panel";
		status = "disable";
		qcom,mdss-dsi-panel-controller = <&mdss_dsi0>;
		qcom,enable-gpio = <&pm8941_gpios 14 0>;
		qcom,rst-gpio = <&pm8941_gpios 19 0>;
		qcom,mdss-pan-res = <720 1280>;
		qcom,mdss-pan-size = <69 124>; /* <Width> <Height> real size of panel in mm */
		qcom,mdss-pan-bpp = <24>;
		qcom,mdss-pan-dest = "display_1";
		qcom,mdss-clk-rate=<500000000>;
		qcom,mdss-pan-porch-values = <128 96 128 1 2 13>; /* <HBP> <HPW> <HFP> <VBP> <VPW> <VFP> */
		qcom,mdss-pan-underflow-clr = <0xff>;
		qcom,mdss-pan-bl-ctrl = "bl_ctrl_dcs_cmds";
		qcom,mdss-pan-bl-levels = <1 255>;
		qcom,mdss-pan-dsi-mode = <0>;
		qcom,mdss-pan-dsi-h-pulse-mode = <0>;
		qcom,mdss-pan-dsi-h-power-stop = <0 0 0>;
		qcom,mdss-pan-dsi-bllp-power-stop = <1 1>;
		qcom,mdss-pan-dsi-traffic-mode = <2>;
		qcom,mdss-pan-dsi-dst-format = <3>;
		qcom,mdss-pan-dsi-vc = <0>;
		qcom,mdss-pan-dsi-rgb-swap = <0>;
		qcom,mdss-force-clk-lane-hs = <1>;
		samsung,mdss-early-lcd-on = <0>;
		qcom,mdss-pan-dsi-data-lanes = <1 1 1 1>;
		qcom,mdss-pan-dsi-dlane-swap = <0>;
		qcom,mdss-pan-dsi-t-clk = <0x1c 0x04>;
		qcom,mdss-pan-dsi-stream = <0>;
		qcom,mdss-pan-dsi-mdp-tr = <0x0>;
		qcom,mdss-pan-dsi-dma-tr = <0x04>;
		qcom,mdss-pan-dsi-frame-rate = <60>;
		qcom,cont-splash-enabled = <1>;
		qcom,panel-phy-regulatorSettings = [07 09 03 00  /* Regualotor settings */
						    20 00 01];
		qcom,panel-phy-timingSettings = [96 27 20 00 39 3A 21 29 32 03 04 00];
		qcom,panel-phy-strengthCtrl = [ff 06];		/*!!!! */
		qcom,panel-phy-bistCtrl = [00 00 b1 ff           /*!!!! BIST Ctrl settings */
					   00 00];
		qcom,panel-phy-laneConfig = [
			00 00 00 00 00 00 00 01 75
			00 00 00 00 05 00 00 01 75
			00 00 00 00 0a 00 00 01 75
			00 00 00 00 0f 00 00 01 75
			00 c0 00 00 00 00 00 01 97]; /* Clk ln config */

		qcom,panel-on-cmds = [
			39 01 00 00 01 00 03 F0 5A 5A
			39 01 00 00 01 00 03 F7 5A 5A

			39 01 00 00 01 00 20
				C4
				54 B3 00 00 64 9D 64 9D
				00 00 00 00 00 0B FA 0B
				FA 0F 0F 0F 39 56 9E 00
				00 00 00 00 00 06 00

			39 01 00 00 01 00 03 F7 A5 A5
			39 01 00 00 01 00 02 36 02
			39 01 00 00 01 00 05 B3 00 06 00 06
			39 01 00 00 01 00 08 B2 0F B4 A0 04 00 00 00
			05 01 00 00 78 00 02 11 00
			39 01 00 00 01 00 03 F7 5A 5A

			39 01 00 00 01 00 21
				CA 01 00 01 00 01 00 80
				80 80 80 80 80 80 80 80
				80 80 80 80 80 80 80 80
				80 80 80 80 80 80 80 00
				00

			39 01 00 00 01 00 03 F7 A5 A5
			39 01 00 00 01 00 05 B3 00 06 00 06
			39 01 00 00 01 00 08 B2 0F B4 A0 04 00 00 00
			39 01 00 00 01 00 04 B4 33 0A 00
			39 01 00 00 01 00 03 F1 5A 5A
			39 01 00 00 01 00 04 D4 18 00 48
			39 01 00 00 01 00 03 F1 A5 A5
			39 01 00 00 01 00 02 55 00
			39 01 00 00 01 00 02 B0 06
			39 01 00 00 01 00 02 B2 19
			39 01 00 00 01 00 03 F1 5A 5A
			39 01 00 00 01 00 02 B0 02
			39 01 00 00 01 00 02 D4 48
			39 01 00 00 01 00 03 F1 A5 A5
			39 01 00 00 01 00 02 B2 0F

			/* ETC, for LCD-TSP sync  */
			39 01 00 00 01 00 03 	F1 5A 5A
			39 01 00 00 01 00 03 	FC 5A 5A
			39 01 00 00 01 00 02 	B0 01
			39 01 00 00 01 00 02 	D7 0A
			39 01 00 00 01 00 02 	FF 0A
			39 01 00 00 01 00 03 	F1 A5 A5
			39 01 00 00 01 00 03 	FC A5 A5

			05 01 00 00 22 00 02 29 00
		];
		qcom,on-cmds-dsi-state = "DSI_LP_MODE";
		qcom,panel-off-cmds = [
			05 01 00 00 22 00 02 28 00
			05 01 00 00 78 00 02 10 00
		];
		qcom,off-cmds-dsi-state = "DSI_HS_MODE";

		qcom,panel-touchsensing-on-cmds = [29 01 00 00 00 00 03 ff 07 01];
		qcom,panel-touchsensing-off-cmds = [29 01 00 00 12 00 03 ff 1f 01];


		/*
			the last byte in read commands  represent READ LENGH,
			like below  READ LENGH = 0x21
		 */
			samsung,panel-nv-mtp-read-cmds = [ 06 01 00 00 00 00 01 c8 21 00];
			samsung,panel-nv-mtp-read-hbm-cmds = [ 06 01 00 00 00 00 01 c8 07 21];	/* read C8 34~40th , 33=0x21*/
			samsung,panel-nv-mtp-read-hbm2-cmds = [ 06 01 00 00 00 00 01 c8 0F 48];	/* read C8 73~87th , 72=0x48*/
			samsung,panel-nv-mdnie-read-cmds = [ 06 01 00 00 00 00 01 A1 04 00];
			samsung,panel-nv-read-cmds = [ 06 01 00 00 00 00 01 c8 21 00];
			samsung,panel-nv-read-enable-cmds = [
								29 01 00 00 00 00 03 f0 5a 5a
								29 01 00 00 00 00 03 fc 5a 5a ];
			samsung,panel-nv-read-disable-cmds = [ 29 01 00 00 00 00 03 f0 a5 a5 ];

			/* the last byte in all read commands will represent READ LENGH */
			magna,panel-read-pos-cmds = [ 39 01 00 00 01 00 02 FD D1 ];
			magna,panel-read-run-cmds = [ 06 01 00 00 00 00 01 FE 03 00 ];
			samsung,panel-manufacture-id-read-cmds = [
							06 01 00 00 00 00 01 D1 03 00
							];

			qcom,panel-display-on-cmds = [05 01 00 00 32 00 02 29 00];
			qcom,panel-display-off-cmds = [05 01 00 00 32 00 02 28 00];

			qcom,panel-display-unblank-cmds = [05 01 00 00 32 00 02 13 00];			/*Normal mode command*/
			qcom,panel-display-blank-cmds = [05 01 00 00 45 00 02 22 00];		 /* All pixel off - for making display black*/

			samsung,panel-acl-off-cmds = [39 01 00 00 72 00 02 55 00];

			samsung,panel-gamma-cmds-list = [
				/* Brightness Control */
				39 01 00 00 01 00 03 F7 5A 5A
				39 01 00 00 01 00 21
					CA 01 00 01 00 01 00 80
					80 80 80 80 80 80 80 80
					80 80 80 80 80 80 80 80
					80 80 80 80 80 80 80 00
					00
				39 01 00 00 01 00 03 F7 A5 A5
			];
			samsung,panel-gamma-hbm-cmds-list = [29 01 00 00 00 00 22            /* Brightness Condition Set - Gamma 2.2 Setting*/
						ca 01 00 01 00 01 00 80
						80 80 80 80 80 80 80 80
						80 80 80 80 80 80 80 80
						80 80 80 80 80 80 80 00
						00 00
					29 01 00 00 00 00 03 F7 03 00  /* Gamma, LTPS(AID) update */
				];
			samsung,panel-etc-hbm-cmds = [
					29 01 00 00 00 00 08 B2 01 00 00 00 00 00 06	/* samsung_brightness_aor_condition */
					29 01 00 00 00 00 03 b6 2c 01 		/* ELVSS  */
					29 01 00 00 00 00 04	B5 01 99 35		/* acl cont */
					29 01 00 00 00 00 05	E3 FF FF FF FF		/* als cont */
					29 01 00 00 00 00 02 55 41	   	/* power saving Set */
					29 01 00 00 00 00 03	BC 20 38		/* psre cont */
/*					29 01 00 00 00 00 3B	BC
	20 38 64 64 00 03 E8 00 00 B2
	C2 C2 AC AE C1 B5 00 78 B1 6C
	00 00 00 00 00 B8 B8 A8 90 90
	A8 A0 00 88 90 90 08 00 00 00
	00 55 55 55 5A 3A 28 28 2A 48
	24 2A 05 05 05 05 05 04
*/
				];

			/*
			 * ************************************************************************************************************************
			 * AID command list and mappings
			 * ************************************************************************************************************************
			 */
			samsung,panel-aid-cmds-list = [
					39 01 00 00 00 00 08	B2 01 00 00 00 00 00 06	 /* 0 samsung_brightness_aor_0 */
					39 01 00 00 00 00 08	B2 09 00 00 00 00 03 06  /* 1 samsung_brightness_aor_40 */
					39 01 00 00 00 00 08	B2 09 00 00 00 00 00 20	 /* 2 samsung_brightness_aor_1p65 */
					39 01 00 00 00 00 08	B2 09 00 00 00 00 00 a5  /* 3 samsung_brightness_aor_8p53 */
					39 01 00 00 00 00 08	B2 09 00 00 00 00 01 03  /* 4 samsung_brightness_aor_13p4 */
					39 01 00 00 00 00 08	B2 09 00 00 00 00 01 72  /* 5 samsung_brightness_aor_19p1 */
					39 01 00 00 00 00 08	B2 09 00 00 00 00 01 CC  /* 6 samsung_brightness_aor_23p8 */
					39 01 00 00 00 00 08	B2 09 00 00 00 00 02 27  /* 7 samsung_brightness_aor_28p5 */
					39 01 00 00 00 00 08	B2 09 00 00 00 00 02 83  /* 8 samsung_brightness_aor_33p2 */
					39 01 00 00 00 00 08	B2 09 00 00 00 00 02 CE  /* 9 samsung_brightness_aor_37p1 */
					39 01 00 00 00 00 08	B2 09 00 00 00 00 03 1B  /* 10 samsung_brightness_aor_41p1 */
					39 01 00 00 00 00 08	B2 09 00 00 00 00 03 69  /* 11 samsung_brightness_aor_45p1 */
					39 01 00 00 00 00 08	B2 09 00 00 00 00 03 AE  /* 12 samsung_brightness_aor_48p7 */
					39 01 00 00 00 00 08	B2 09 00 00 00 00 03 E2  /* 13 samsung_brightness_aor_51p4 */
					39 01 00 00 00 00 08	B2 09 00 00 00 00 04 16  /* 14 samsung_brightness_aor_54p1 */
					39 01 00 00 00 00 08	B2 09 00 00 00 00 04 4E  /* 15 samsung_brightness_aor_57p0 */
					39 01 00 00 00 00 08	B2 09 00 00 00 00 04 86  /* 16 samsung_brightness_aor_59p9 */
					39 01 00 00 00 00 08	B2 09 00 00 00 00 04 BF  /* 17 samsung_brightness_aor_62p8 */
					39 01 00 00 00 00 08	B2 09 00 00 00 00 04 E3  /* 18 samsung_brightness_aor_64p7 */
					39 01 00 00 00 00 08	B2 09 00 00 00 00 05 06  /* 19 samsung_brightness_aor_66p5 */
					39 01 00 00 00 00 08	B2 09 00 00 00 00 05 3B  /* 20 samsung_brightness_aor_69p2 */
					39 01 00 00 00 00 08	B2 09 00 00 00 00 05 5E  /* 21 samsung_brightness_aor_71p0 */
					39 01 00 00 00 00 08	B2 09 00 00 00 00 05 82  /* 22 samsung_brightness_aor_72p9 */
					39 01 00 00 00 00 08	B2 09 00 00 00 00 05 92  /* 23 samsung_brightness_aor_73p7 */
					39 01 00 00 00 00 08	B2 09 00 00 00 00 05 B3  /* 24 samsung_brightness_aor_75p4 */
					39 01 00 00 00 00 08	B2 09 00 00 00 00 05 D4  /* 25 samsung_brightness_aor_77p1 */
					39 01 00 00 00 00 08	B2 09 00 00 00 00 05 E5  /* 26 samsung_brightness_aor_78p0 */
					39 01 00 00 00 00 08	B2 09 00 00 00 00 06 06  /* 27 samsung_brightness_aor_79p7 */
					39 01 00 00 00 00 08	B2 09 00 00 00 00 06 16  /* 28 samsung_brightness_aor_80p6 */
					39 01 00 00 00 00 08	B2 09 00 00 00 00 06 27  /* 29 samsung_brightness_aor_81p4 */
					39 01 00 00 00 00 08	B2 09 00 00 00 00 06 38  /* 30 samsung_brightness_aor_82p3 */
					39 01 00 00 00 00 08	B2 09 00 00 00 00 06 5B  /* 31 samsung_brightness_aor_84p1 */
					39 01 00 00 00 00 08	B2 09 00 00 00 00 06 6C  /* 32 samsung_brightness_aor_85p0 */
					39 01 00 00 00 00 08	B2 09 00 00 00 00 06 7D  /* 33 samsung_brightness_aor_85p9 */
					39 01 00 00 00 00 08	B2 09 00 00 00 00 06 8F  /* 34 samsung_brightness_aor_86p8 */
					39 01 00 00 00 00 08	B2 09 00 00 00 00 06 A0  /* 35 samsung_brightness_aor_87p7 */
					39 01 00 00 00 00 08	B2 09 00 00 00 00 06 B2  /* 36 samsung_brightness_aor_88p6 */
					39 01 00 00 00 00 08	B2 09 00 00 00 00 06 C3  /* 37 samsung_brightness_aor_89p5 */
					39 01 00 00 00 00 08	B2 09 00 00 00 00 06 D5  /* 38 samsung_brightness_aor_90p4 */
					39 01 00 00 00 00 08	B2 01 00 00 00 00 00 06  /* 39 samsung_brightness_aor_ref */
				];
			/* bl_level, Index in acl command list */
			samsung,panel-aid-map-table = <
					10   38        11   37       12   36       13   35     14   34
					15   33        16   32       17   31       19   30     20   29
					21   28        22   27       24   26       25   25     27   24
					29   23        30   22       32   21       34   20     37   19
					39   18        41   17       44   16       47   15     50   14
					53   13        56   12       60   11       64   10     68   9
					72   8         77   7        82   6        87   5      93   4
					98   3         105  2        111  1        119  1      126  1
					134  1         143  1        152  1        162  1      172  1
					183  0         195  0        207  0        220  0      234  0
					249  0         265  0        282  0        300  0
				>;

			/*
			 * ************************************************************************************************************************
			 * ACL command list and mappings
			 * ************************************************************************************************************************
			 */
			samsung,panel-aclcont-cmds-list = [
					39 01 00 00 00 00 02	55 01	/* 2 : 30% */
			 ];
			samsung,panel-acl-cmds-list = [
					39 01 00 00 00 00 02	55 00	/* 0 : off */
					39 01 00 00 00 00 02	55 01	/* 1 : 30% */
					39 01 00 00 00 00 02	55 02	/* 2 : 25% */
					39 01 00 00 00 00 02	55 03];	/* 3 : 50% */
			/* bl_level , Index in acl command list */
			samsung,panel-acl-map-table =  <
					10   1         11   1        12   1         13   1      14   1
					15   1         16   1        17   1         19   1      20   1
					21   1         22   1        24   1         25   1      27   1
					29   1         30   1        32   1         34   1      37   1
					39   1         41   1        44   1         47   1      50   1
					53   1         56   1        60   1         64   1      68   1
					72   1         77   1        82   1         87   1      93   1
					98   1         105  1        111  1         119  1      126  1
					134  1         143  1        152   1        162  1     172   1
					183  1         195  1        207   1        220  1     234   1
					249  1         265  1        282   1        300  1
				>;

			/*
			 * ************************************************************************************************************************
			 * ELVSS command list and mappings
			 * ************************************************************************************************************************
			 */
			samsung,panel-elvss-cmds-list = [
					39 01 00 00 00 00 08	B2 0F B4 A0 04 00 00 00	/* 00 : 350 nit */
					39 01 00 00 00 00 08	B2 10 B4 A0 04 00 00 00	/* 01 : 333 nit */
					39 01 00 00 00 00 08	B2 12 B4 A0 04 00 00 00	/* 02 : 316 nit */
					39 01 00 00 00 00 08	B2 13 B4 A0 04 00 00 00	/* 03 : 300 nit */
					39 01 00 00 00 00 08	B2 15 B4 A0 04 00 00 00	/* 04 : 282 nit */
					39 01 00 00 00 00 08	B2 16 B4 A0 04 00 00 00	/* 05 : 265 nit */
					39 01 00 00 00 00 08	B2 17 B4 A0 04 00 00 00	/* 06 : 249 nit */
					39 01 00 00 00 00 08	B2 19 B4 A0 04 00 00 00	/* 07 : 234 nit */
					39 01 00 00 00 00 08	B2 1A B4 A0 04 00 00 00	/* 08 : 220 nit */
					39 01 00 00 00 00 08	B2 1B B4 A0 04 00 00 00	/* 09 : 207 nit */
					39 01 00 00 00 00 08	B2 1C B4 A0 04 00 00 00	/* 10 : 195 nit */
					39 01 00 00 00 00 08	B2 1D B4 A0 04 00 00 00	/* 11 : 183 nit */
					39 01 00 00 00 00 08	B2 1C B4 A0 04 00 00 00	/* 12 : 181 nit */
					39 01 00 00 00 00 08	B2 1B B4 A0 04 00 00 00	/* 13 : 179 nit */
					39 01 00 00 00 00 08	B2 1A B4 A0 04 00 00 00	/* 14 : 177 nit */
					39 01 00 00 00 00 08	B2 19 B4 A0 04 00 00 00	/* 15 : 175 nit */
					39 01 00 00 00 00 08	B2 18 B4 A0 04 00 00 00	/* 16 : 173 nit */
					39 01 00 00 00 00 08	B2 1A B4 A0 04 00 00 00	/* 17 : 162 nit */
					39 01 00 00 00 00 08	B2 1B B4 A0 04 00 00 00	/* 18 : 152 nit */
					39 01 00 00 00 00 08	B2 1C B4 A0 04 00 00 00	/* 19 : 143 nit */
					39 01 00 00 00 00 08	B2 1D B4 A0 04 00 00 00	/* 20 : 134 nit */
					39 01 00 00 00 00 08	B2 1E B4 A0 04 00 00 00	/* 21 : 126 nit */
					39 01 00 00 00 00 08	B2 1F B4 A0 04 00 00 00	/* 22 : 111 nit */
					39 01 00 00 00 00 08	B2 20 B4 A0 04 00 00 00	/* 23 : 109 nit */
					39 01 00 00 00 00 08	B2 21 B4 A0 04 00 00 00	/* 24 : 107 nit */
					39 01 00 00 00 00 08	B2 22 B4 A0 04 00 00 00	/* 25 : 106~5 nit */
				];
			samsung,panel-elvss-lowtemp-cmds-list = [
					39 01 00 00 00 00 08	B2 0F B4 A0 04 00 00 00	/* 350 nit */
				];
			samsung,panel-elvss-cmds-tempcompen-list = [29 01 00 00 00 00 08 B8 38 07 30 00 28 19 02];

			/* bl_level, Index in elvss command list */
			samsung,panel-elvss-map-table = <
					/* Temporary ELVSS : no-smartdimming */
					10   11	       11   11       12   11        13   11     14   11
					15   11        16   11       17   11        19   11     20   11
					21   11        22   11       24   11        25   11     27   11
					29   11        30   11       32   11        34   11     37   11
					39   11        41   11       44   11        47   11     50   11
					53   11        56   11       60   11        64   11     68   11
					72   11        77   11       82   11        87   11     93   11
					98   11        105  11       111  11        119  11     126  11
					134  11        143  11       152  11        162  11     172  11
					183  11        195  10       207  9         220  8      234  7
					249  6         265  5        282  4         300  3
					>;
			/*
			samsung,panel-elvss-map-table = <
					10   25	       11   25       12   25        13   25     14   25
					15   25        16   25       17   25        19   25     20   25
					21   25        22   25       24   25        25   25     27   25
					29   25        30   25       32   25        34   25     37   25
					39   25        41   25       44   25        47   25     50   25
					53   25        56   25       60   25        64   25     68   25
					72   25        77   25       82   25        87   25     93   25
					98   25        105  25       111  22        119  21     126  21
					134  20        143  19       152  18        162  17     172  16
					183  11        195  10       207  9         220  8      234  7
					249  6         265  5        282  4         300  3
					>;
*/
			/*
			 * ************************************************************************************************************************
			 * candela to index mappings
			 * ************************************************************************************************************************
			 */
			samsung,panel-candella-mapping-table = <
				/*<idx>		<from>		<till>		<candella> */
				0		0		10		10
				1		11		11		11
				2		12		12		12
				3		13		13		13
				4		14		14		14
				5		15		15		15
				6		16		16		16
				7		17		18		17
				8		19		19		19
				9		20		20		20
				10		21		21		21
				11		22		23		22
				12		24		24		24
				13		25		26		25
				14		27		28		27
				15		29		29		29
				16		30		31		30
				17		32		32		32
				18		33		36		34
				19		37		38		37
				20		39		40		39
				21		41		43		41
				22		44		46		44
				23		47		49		47
				24		50		52		50
				25		53		55		53
				26		56		59		56
				27		60		63		60
				28		64		67		64
				29		68		71		68
				30		72		76		72
				31		77		81		77
				32		82		86		82
				33		87		92		87
				34		93		97		93
				35		98		104		98
				36		105		110		105
				37		111		118		111
				38		119		125		119
				39		126		133		126
				40		134		142		134
				41		143		149		143
				42		150		161		152
				43		162		171		162
				44		172		182		172
				45		183		194		183
				46		195		206		195
				47		207		219		207
				48		220		232		220
				49		233		248		234
				50		249		249		249
				51		250		251		265
				52		252		253		282
				53		254		255		300
				>;
			/* Lux table mapping for Smart dimming*/
			samsung,panel-smart-dimming-lux-table = <
				10  11  12  13  14
				15  16  17  19  20
				21  22  24  25  27
				29  30  32  34  37
				39  41  44  47  50
				53  56  60  64  68
				72  77  82  87  93
				98  105 111 119 126
				134 143 152 162 172
				183 195 207 220 234
				249 265 282 300>;
	};
};