/* Copyright (c) 2012, Samsung Electronics Corporation. All rights reserved.
 *
 * This program is free software; you can redistribute it and/or modify
 * it under the terms of the GNU General Public License version 2 and
 * only version 2 as published by the Free Software Foundation.
 *
 * This program is distributed in the hope that it will be useful,
 * but WITHOUT ANY WARRANTY; without even the implied warranty of
 * MERCHANTABILITY or FITNESS FOR A PARTICULAR PURPOSE.  See the
 * GNU General Public License for more details.
 */

&mdss_mdp {
	dsi_samsung_720p_fresco: mdss_dsi_samsung_octa_720p_video_s6e8aa4 {
		qcom,mdss-dsi-panel-name = "samsung,mdss-amoled-dsi-panel";
		label = "samsung amoled 720p video mode dsi S6E8AA4 panel";
		status = "disable";
		qcom,mdss-dsi-panel-controller = <&mdss_dsi0>;
		qcom,enable-gpio = <&pm8941_gpios 14 0>;
		qcom,rst-gpio = <&pm8941_gpios 19 0>;
		qcom,mdss-pan-res = <720 1280>;
		qcom,mdss-pan-size = <69 124>; /* <Width> <Height> real size of panel in mm */
		qcom,mdss-pan-bpp = <24>;
		qcom,mdss-pan-dest = "display_1";
		qcom,mdss-clk-rate=<488000000>;
		qcom,mdss-pan-porch-values = <100 96 128 3 2 13>; /* <HBP> <HPW> <HFP> <VBP> <VPW> <VFP> */
		qcom,mdss-pan-underflow-clr = <0xff>;
		qcom,mdss-pan-bl-ctrl = "bl_ctrl_dcs_cmds";
		qcom,mdss-pan-bl-levels = <1 255>;
		qcom,mdss-pan-dsi-mode = <0>;
		qcom,mdss-pan-dsi-h-pulse-mode = <0>;
		qcom,mdss-pan-dsi-h-power-stop = <0 0 0>;
		qcom,mdss-pan-dsi-bllp-power-stop = <1 1>;
		qcom,mdss-pan-dsi-traffic-mode = <2>;
		qcom,mdss-pan-dsi-dst-format = <3>;
		qcom,mdss-pan-dsi-vc = <0>;
		qcom,mdss-pan-dsi-rgb-swap = <0>;
		qcom,mdss-force-clk-lane-hs = <1>;
		samsung,mdss-early-lcd-on = <1>;
		qcom,mdss-pan-dsi-data-lanes = <1 1 1 1>;
		qcom,mdss-pan-dsi-dlane-swap = <0>;
		qcom,mdss-pan-dsi-t-clk = <0x1c 0x04>;
		qcom,mdss-pan-dsi-stream = <0>;
		qcom,mdss-pan-dsi-mdp-tr = <0x0>;
		qcom,mdss-pan-dsi-dma-tr = <0x04>;
		qcom,mdss-pan-dsi-frame-rate = <60>;
		qcom,panel-phy-regulatorSettings = [07 09 03 00  /* Regualotor settings */
						    20 00 01];
		qcom,panel-phy-timingSettings = [96 27 20 00 39 3A 21 29 32 03 04 00];
		qcom,panel-phy-strengthCtrl = [ff 06];		/*!!!! */
		qcom,panel-phy-bistCtrl = [00 00 b1 ff           /*!!!! BIST Ctrl settings */
					   00 00];
		qcom,panel-phy-laneConfig = [
			00 00 00 00 00 00 00 01 75
			00 00 00 00 05 00 00 01 75
			00 00 00 00 0a 00 00 01 75
			00 00 00 00 0f 00 00 01 75
			00 c0 00 00 00 00 00 01 97]; /* Clk ln config */

		qcom,panel-on-cmds = [
			29 01 00 00 00 00 03 f0 5a 5a /* Tesk key ON */
			05 01 00 00 78 00 02 11 00 /* Sleep out */
			29 01 00 00 00 00 22       /* Brightness Condition Set - Gamma 2.2 Setting*/
			ca 01 00 01 00 01 00 80
			80 80 80 80 80 80 80 80
			80 80 80 80 80 80 80 80
			80 80 80 80 80 80 80 00
			00 00
			29 01 00 00 00 00 05 B2 00 06 00 06
			29 01 00 00 00 00 03 B6 88 0F
			29 01 00 00 00 00 03 F7 03 00  /* Gamma, LTPS(AID) update */
			23 01 00 00 00 00 02 55 00 /* acl */

			23 01 00 00 00 00 02 B0 05 /* elvss */
			23 01 00 00 00 00 02 B8 19
			29 01 00 00 00 00 03 B6 88 0F

			23 01 00 00 00 00 02 55 00	   /* Etc Cond Set */
			23 01 00 00 00 00 03 f7 03	00	/* samsung_gamma_update */

			29 01 00 00 00 00 03 FC 5A 5A /* level3 key unlock */
			29 01 00 00 00 00 03 FF 00 02 /* monitoring signal set */
			29 01 00 00 00 00 03 FC A5 A5 /* level3 key lock */

			05 01 00 00 11 00 02 29 00
		];
		qcom,on-cmds-dsi-state = "DSI_LP_MODE";
		qcom,panel-off-cmds = [
			05 01 00 00 22 00 02 28 00
			05 01 00 00 78 00 02 10 00
		];
		qcom,off-cmds-dsi-state = "DSI_HS_MODE";

		qcom,panel-touchsensing-on-cmds = [29 01 00 00 00 00 03 ff 07 01];
		qcom,panel-touchsensing-off-cmds = [29 01 00 00 12 00 03 ff 1f 01];

		/*
			the last byte in read commands  represent READ LENGH,
			like below  READ LENGH = 0x21
		 */
			samsung,panel-nv-mtp-read-cmds = [ 06 01 00 00 00 00 01 c8 21 00];
			samsung,panel-nv-mtp-read-hbm-cmds = [ 06 01 00 00 00 00 01 c8 06 21];	/* read C8 34~39th , 33=0x21*/
			samsung,panel-nv-mtp-read-hbm2-cmds = [ 06 01 00 00 00 00 01 c8 0F 48];	/* read C8 73~87th , 72=0x48*/
			samsung,panel-nv-mdnie-read-cmds = [ 06 01 00 00 00 00 01 A1 04 00];
			samsung,panel-nv-read-cmds = [ 06 01 00 00 00 00 01 c8 21 00];
			samsung,panel-nv-read-enable-cmds = [
								29 01 00 00 00 00 03 f0 5a 5a
								29 01 00 00 00 00 03 fc 5a 5a ];
			samsung,panel-nv-read-disable-cmds = [ 29 01 00 00 00 00 03 f0 a5 a5 ];

			/* the last byte in all read commands will represent READ LENGH */
			samsung,panel-manufacture-id-read-cmds = [
								06 01 00 00 00 00 01 da 01 00
								06 01 00 00 00 00 01 db 01 00
								06 01 00 00 00 00 01 dc 01 00];

			qcom,panel-display-on-cmds = [05 01 00 00 32 00 02 29 00];
			qcom,panel-display-off-cmds = [05 01 00 00 32 00 02 28 00];

			qcom,panel-display-unblank-cmds = [05 01 00 00 32 00 02 13 00];			/*Normal mode command*/
			qcom,panel-display-blank-cmds = [05 01 00 00 45 00 02 22 00];		 /* All pixel off - for making display black*/

			samsung,panel-acl-off-cmds = [29 01 00 00 72 00 02 55 00];

			samsung,panel-gamma-cmds-list = [
					29 01 00 00 00 00 22       /* Brightness Condition Set - Gamma 2.2 Setting*/
					ca 01 00 01 00 01 00 80
					80 80 80 80 80 80 80 80
					80 80 80 80 80 80 80 80
					80 80 80 80 80 80 80 00
					00 00
					29 01 00 00 00 00 03 F7 03 00  /* Gamma, LTPS(AID) update */
				];

			samsung,panel-gamma-hbm-cmds-list = [
					29 01 00 00 00 00 22            /* Brightness Condition Set - Gamma 2.2 Setting*/
					ca 01 00 01 00 01 00 80
					80 80 80 80 80 80 80 80
					80 80 80 80 80 80 80 80
					80 80 80 80 80 80 80 00
					00 00
					29 01 00 00 00 00 03 F7 03 00  /* Gamma, LTPS(AID) update */
				];
			samsung,panel-etc-hbm-cmds = [
					29 01 00 00 00 00 08 B2 01 00 00 00 00 00 06	/* samsung_brightness_aor_condition */
					29 01 00 00 00 00 03 b6 2c 01			/* ELVSS  */
					29 01 00 00 00 00 04 B5 01 99 35		/* acl cont */
					29 01 00 00 00 00 05 E3 FF FF FF FF		/* als cont */
					29 01 00 00 00 00 02 55 41			/* power saving Set */
					29 01 00 00 00 00 03 BC 20 38			/* psre cont */
/*	29 01 00 00 00 00 3B BC
	20 38 64 64 00 03 E8 00 00 B2
	C2 C2 AC AE C1 B5 00 78 B1 6C
	00 00 00 00 00 B8 B8 A8 90 90
	A8 A0 00 88 90 90 08 00 00 00
	00 55 55 55 5A 3A 28 28 2A 48
	24 2A 05 05 05 05 05 04
*/
				];

			/*
			 * ************************************************************************************************************************
			 * AID command list and mappings
			 * ************************************************************************************************************************
			 */
			samsung,panel-aid-cmds-list = [

					29 01 00 00 00 00 03	B2 04 D5	/* 0 samsung_brightness_aor_95p4 */
					29 01 00 00 00 00 03	B2 04 C8	/* 1 samsung_brightness_aor_94p4 */
					29 01 00 00 00 00 03	B2 04 C3	/* 2 samsung_brightness_aor_94p1 */
					29 01 00 00 00 00 03	B2 04 B5	/* 3 samsung_brightness_aor_93p0 */
					29 01 00 00 00 00 03	B2 04 A7	/* 4 samsung_brightness_aor_91p9 */
					29 01 00 00 00 00 03	B2 04 A1	/* 5 samsung_brightness_aor_91p4 */
					29 01 00 00 00 00 03	B2 04 94	/* 6 samsung_brightness_aor_90p4 */
					29 01 00 00 00 00 03	B2 04 87	/* 7 samsung_brightness_aor_89p4 */
					29 01 00 00 00 00 03	B2 04 81	/* 8 samsung_brightness_aor_89p0 */
					29 01 00 00 00 00 03	B2 04 73	/* 9 samsung_brightness_aor_87p9 */
					29 01 00 00 00 00 03	B2 04 65	/* 10 samsung_brightness_aor_86p8 */
					29 01 00 00 00 00 03	B2 04 57	/* 11 samsung_brightness_aor_85p7 */
					29 01 00 00 00 00 03	B2 04 51	/* 12 samsung_brightness_aor_85p3 */
					29 01 00 00 00 00 03	B2 04 35	/* 13 samsung_brightness_aor_83p1 */
					29 01 00 00 00 00 03	B2 04 29	/* 14 samsung_brightness_aor_82p2 */
					29 01 00 00 00 00 03	B2 04 22	/* 15 samsung_brightness_aor_81p6 */
					29 01 00 00 00 00 03	B2 04 15	/* 16 samsung_brightness_aor_80p6 */
					29 01 00 00 00 00 03	B2 04 00	/* 17 samsung_brightness_aor_79p0 */
					29 01 00 00 00 00 03	B2 03 F2	/* 18 samsung_brightness_aor_77p9 */
					29 01 00 00 00 00 03	B2 03 D6	/* 19 samsung_brightness_aor_75p8 */
					29 01 00 00 00 00 03	B2 03 C3	/* 20 samsung_brightness_aor_74p3 */
					29 01 00 00 00 00 03	B2 03 B5	/* 21 samsung_brightness_aor_73p2 */
					29 01 00 00 00 00 03	B2 03 A1	/* 22 samsung_brightness_aor_71p7 */
					29 01 00 00 00 00 03	B2 03 85	/* 23 samsung_brightness_aor_69p5 */
					29 01 00 00 00 00 03	B2 03 63	/* 24 samsung_brightness_aor_66p9 */
					29 01 00 00 00 00 03	B2 03 46	/* 25 samsung_brightness_aor_64p7 */
					29 01 00 00 00 00 03	B2 03 32	/* 26 samsung_brightness_aor_63p1 */
					29 01 00 00 00 00 03	B2 03 08	/* 27 samsung_brightness_aor_59p9 */
					29 01 00 00 00 00 03	B2 02 E6	/* 28 samsung_brightness_aor_57p3 */
					29 01 00 00 00 00 03	B2 02 C3	/* 29 samsung_brightness_aor_54p6 */
					29 01 00 00 00 00 03	B2 02 A0	/* 30 samsung_brightness_aor_51p9 */
					29 01 00 00 00 00 03	B2 02 76	/* 31 samsung_brightness_aor_48p6 */
					29 01 00 00 00 00 03	B2 02 45	/* 32 samsung_brightness_aor_44p8 */
					29 01 00 00 00 00 03	B2 02 13	/* 33 samsung_brightness_aor_41p0 */
					29 01 00 00 00 00 03	B2 01 E2	/* 34 samsung_brightness_aor_37p2 */
					29 01 00 00 00 00 03	B2 01 A8	/* 35 samsung_brightness_aor_32p7 */
					29 01 00 00 00 00 03	B2 01 67	/* 36 samsung_brightness_aor_27p7 */
					29 01 00 00 00 00 03	B2 01 27	/* 37 samsung_brightness_aor_22p8 */
					29 01 00 00 00 00 03	B2 00 E6	/* 38 samsung_brightness_aor_17p7 */
					29 01 00 00 00 00 03	B2 00 96	/* 39 samsung_brightness_aor_11p6 */
					29 01 00 00 00 00 03	B2 00 55	/* 40 samsung_brightness_aor_6p6 */
					29 01 00 00 00 00 03	B2 00 06	/* 41 samsung_brightness_aor_0p5 */
					29 01 00 00 00 00 03	B2 02 06	/* 42 samsung_brightness_aor_40p0 */
					29 01 00 00 00 00 03	B2 00 06	/* 43 samsung_brightness_aor_0p5 */
				];
			/* bl_level, Index in acl command list */
			samsung,panel-aid-map-table = <
					5    0         6    1        7    2        8    3      9    4
					10   5         11   6        12   7        13   8      14   9
					15   10        16   11       17   12       19   13     20   14
					21   15        22   16       24   17       25   18     27   19
					29   20        30   21       32   22       34   23     37   24
					39   25        41   26       44   27       47   28     50   29
					53   30        56   31       60   32       64   33     68   34
					72   35        77   36       82   37       87   38     93   39
					98   40        105  41       111  42       119  42     126  42
					134  42        143  42       152  42       162  42     172  42
					183  43        195  43       207  43       220  43     234  43
					249  43        265  43       282  43       300  43
				>;

			/*
			 * ************************************************************************************************************************
			 * ACL command list and mappings
			 * ************************************************************************************************************************
			 */
			/* B5h
			 * 1st - 0x01 : PSRE , 0x03 : no PSRE
			 * 2nd(OPR) - 0x99 : 60%
			 * 3rd(ACL) - 0x23 : 27.6% , 0x27 : 30%, 0x35 : 40%
			 */
			samsung,panel-aclcont-cmds-list = [
					29 01 00 00 00 00 04	B5 03 99 35	 /* 0x27 : 30% */
			 ];
			samsung,panel-acl-cmds-list = [
					23 01 00 00 00 00 02 55 00 /* 0 */
					23 01 00 00 00 00 02 55 01 /* 1 */
					23 01 00 00 00 00 02 55 02 /* 2 */
					23 01 00 00 00 00 02 55 03 /* 3 */
			];
			/* bl_level , Index in acl command list */
			samsung,panel-acl-map-table =  <
					5    1         6    1        7    1         8    1      9    1
					10   1         11   1        12   1         13   1      14   1
					15   1         16   1        17   1         19   1      20   1
					21   1         22   1        24   1         25   1      27   1
					29   1         30   1        32   1         34   1      37   1
					39   1         41   1        44   1         47   1      50   1
					53   1         56   1        60   1         64   1      68   1
					72   1         77   1        82   1         87   1      93   1
					98   1         105  1        111  1         119  1      126  1
					134  1         143  1        152   1        162  1     172   1
					183  1         195  1        207   1        220  1     234   1
					249  1         265  1        282   1        300  1     350   1
				>;

			/*
			 * ************************************************************************************************************************
			 * ELVSS command list and mappings
			 * ************************************************************************************************************************
			 */
			samsung,panel-elvss-cmds-list = [
					29 01 00 00 00 00 11 b6 88 22 00 00 00 00 00 00 00 00 00 00 00 00 00 00	/* 0 */
					29 01 00 00 00 00 11 b6 88 1f 00 00 00 00 00 00 00 00 00 00 00 00 00 00	/* 1 */
					29 01 00 00 00 00 11 b6 88 1e 00 00 00 00 00 00 00 00 00 00 00 00 00 00	/* 2 */
					29 01 00 00 00 00 11 b6 88 1e 00 00 00 00 00 00 00 00 00 00 00 00 00 00	/* 3 */
					29 01 00 00 00 00 11 b6 88 1d 00 00 00 00 00 00 00 00 00 00 00 00 00 00	/* 4 */
					29 01 00 00 00 00 11 b6 88 1c 00 00 00 00 00 00 00 00 00 00 00 00 00 00	/* 5 */
					29 01 00 00 00 00 11 b6 88 1b 00 00 00 00 00 00 00 00 00 00 00 00 00 00	/* 6 */
					29 01 00 00 00 00 11 b6 88 1a 00 00 00 00 00 00 00 00 00 00 00 00 00 00	/* 7 */
					29 01 00 00 00 00 11 b6 88 18 00 00 00 00 00 00 00 00 00 00 00 00 00 00	/* 8 */
					29 01 00 00 00 00 11 b6 88 1d 00 00 00 00 00 00 00 00 00 00 00 00 00 00	/* 9 */
					29 01 00 00 00 00 11 b6 88 1c 00 00 00 00 00 00 00 00 00 00 00 00 00 00	/* 10 */
					29 01 00 00 00 00 11 b6 88 1b 00 00 00 00 00 00 00 00 00 00 00 00 00 00	/* 11 */
					29 01 00 00 00 00 11 b6 88 1a 00 00 00 00 00 00 00 00 00 00 00 00 00 00	/* 12 */
					29 01 00 00 00 00 11 b6 88 19 00 00 00 00 00 00 00 00 00 00 00 00 00 00	/* 13 */
					29 01 00 00 00 00 11 b6 88 17 00 00 00 00 00 00 00 00 00 00 00 00 00 00	/* 14 */
					29 01 00 00 00 00 11 b6 88 16 00 00 00 00 00 00 00 00 00 00 00 00 00 00	/* 15 */
					29 01 00 00 00 00 11 b6 88 15 00 00 00 00 00 00 00 00 00 00 00 00 00 00	/* 16 */
					29 01 00 00 00 00 11 b6 88 13 00 00 00 00 00 00 00 00 00 00 00 00 00 00	/* 17 */
					29 01 00 00 00 00 11 b6 88 12 00 00 00 00 00 00 00 00 00 00 00 00 00 00	/* 18 */
					29 01 00 00 00 00 11 b6 88 10 00 00 00 00 00 00 00 00 00 00 00 00 00 00	/* 19 */
					29 01 00 00 00 00 11 b6 88 0f 00 00 00 00 00 00 00 00 00 00 00 00 00 00	/* 20 */
				];
			samsung,panel-elvss-lowtemp-cmds-list = [
					29 01 00 00 00 00 11 b6 8c 22 00 00 00 00 00 00 00 00 00 00 00 00 00 00	/* 0 */
					29 01 00 00 00 00 11 b6 8c 1f 00 00 00 00 00 00 00 00 00 00 00 00 00 00	/* 1 */
					29 01 00 00 00 00 11 b6 8c 1e 00 00 00 00 00 00 00 00 00 00 00 00 00 00	/* 2 */
					29 01 00 00 00 00 11 b6 8c 1e 00 00 00 00 00 00 00 00 00 00 00 00 00 00	/* 3 */
					29 01 00 00 00 00 11 b6 8c 1d 00 00 00 00 00 00 00 00 00 00 00 00 00 00	/* 4 */
					29 01 00 00 00 00 11 b6 8c 1c 00 00 00 00 00 00 00 00 00 00 00 00 00 00	/* 5 */
					29 01 00 00 00 00 11 b6 8c 1b 00 00 00 00 00 00 00 00 00 00 00 00 00 00	/* 6 */
					29 01 00 00 00 00 11 b6 8c 1a 00 00 00 00 00 00 00 00 00 00 00 00 00 00	/* 7 */
					29 01 00 00 00 00 11 b6 8c 18 00 00 00 00 00 00 00 00 00 00 00 00 00 00	/* 8 */
					29 01 00 00 00 00 11 b6 8c 1d 00 00 00 00 00 00 00 00 00 00 00 00 00 00	/* 9 */
					29 01 00 00 00 00 11 b6 8c 1c 00 00 00 00 00 00 00 00 00 00 00 00 00 00	/* 10 */
					29 01 00 00 00 00 11 b6 8c 1b 00 00 00 00 00 00 00 00 00 00 00 00 00 00	/* 11 */
					29 01 00 00 00 00 11 b6 8c 1a 00 00 00 00 00 00 00 00 00 00 00 00 00 00	/* 12 */
					29 01 00 00 00 00 11 b6 8c 19 00 00 00 00 00 00 00 00 00 00 00 00 00 00	/* 13 */
					29 01 00 00 00 00 11 b6 8c 17 00 00 00 00 00 00 00 00 00 00 00 00 00 00	/* 14 */
					29 01 00 00 00 00 11 b6 8c 16 00 00 00 00 00 00 00 00 00 00 00 00 00 00	/* 15 */
					29 01 00 00 00 00 11 b6 8c 15 00 00 00 00 00 00 00 00 00 00 00 00 00 00	/* 16 */
					29 01 00 00 00 00 11 b6 8c 13 00 00 00 00 00 00 00 00 00 00 00 00 00 00	/* 17 */
					29 01 00 00 00 00 11 b6 8c 12 00 00 00 00 00 00 00 00 00 00 00 00 00 00	/* 18 */
					29 01 00 00 00 00 11 b6 8c 10 00 00 00 00 00 00 00 00 00 00 00 00 00 00	/* 19 */
					29 01 00 00 00 00 11 b6 8c 0f 00 00 00 00 00 00 00 00 00 00 00 00 00 00	/* 20 */
				];
			samsung,panel-elvss-cmds-tempcompen-list = [29 01 00 00 00 00 08 B8 38 07 30 00 28 19 02];

			/* bl_level, Index in elvss command list */
			samsung,panel-elvss-map-table = <
					5    0         6    0        7    0         8    0      9    0
					10   0         11   0        12   0         13   0      14   0
					15   0         16   0        17   0         19   0      20   0
					21   0         22   0        24   0         25   0      27   0
					29   0         30   0        32   0         34   0      37   0
					39   0         41   0        44   0         47   0      50   0
					53   0         56   0        60   0         64   0      68   0
					72   0         77   0        82   0         87   0      93   0
					98   0         105  0        111  1         119  2      126  3
					134  4         143  5        152  6         162  7      172  8
					183  9         195  10       207  11        220  12     234  13
					249  14        265  15       282  16        300  17     350  20
					>;
			/*
			 * ************************************************************************************************************************
			 * candela to index mappings
			 * ************************************************************************************************************************
			 */
			samsung,panel-candella-mapping-table = <
			/*<idx>	  <from>  <till> <candella> */
				0		0		5		5
				1		6		6		6
				2		7		7		7
				3		8		8		8
				4		9		9		9
				5		10		10		10
				6		11		11		11
				7		12		12		12
				8		13		13		13
				9		14		14		14
				10		15		15		15
				11		16		16		16
				12		17		18		17
				13		19		19		19
				14		20		20		20
				15		21		21		21
				16		22		23		22
				17		24		24		24
				18		25		26		25
				19		27		28		27
				20		29		29		29
				21		30		31		30
				22		32		32		32
				23		33		36		34
				24		37		38		37
				25		39		40		39
				26		41		43		41
				27		44		46		44
				28		47		49		47
				29		50		52		50
				30		53		55		53
				31		56		59		56
				32		60		63		60
				33		64		67		64
				34		68		71		68
				35		72		76		72
				36		77		81		77
				37		82		86		82
				38		87		92		87
				39		93		97		93
				40		98		104		98
				41		105		110		105
				42		111		118		111
				43		119		125		119
				44		126		133		126
				45		134		142		134
				46		143		149		143
				47		150		161		152
				48		162		171		162
				49		172		182		172
				50		183		194		183
				51		195		206		195
				52		207		219		207
				53		220		232		220
				54		233		248		234
				55		249		249		249
				56		250		251		265
				57		252		253		282
				58		254		255		300
				>;

			samsung,panel-candella-mapping-table-350 = <
			/*<idx>	  <from>  <till> <candella> */
				0		0		5		5
				1		6		6		6
				2		7		7		7
				3		8		8		8
				4		9		9		9
				5		10		10		10
				6		11		11		11
				7		12		12		12
				8		13		13		13
				9		14		14		14
				10		15		15		15
				11		16		16		16
				12		17		18		17
				13		19		19		19
				14		20		20		20
				15		21		21		21
				16		22		23		22
				17		24		24		24
				18		25		26		25
				19		27		28		27
				20		29		29		29
				21		30		31		30
				22		32		32		32
				23		33		36		34
				24		37		38		37
				25		39		40		39
				26		41		43		41
				27		44		46		44
				28		47		49		47
				29		50		52		50
				30		53		55		53
				31		56		59		56
				32		60		63		60
				33		64		67		64
				34		68		71		68
				35		72		76		72
				36		77		81		77
				37		82		86		82
				38		87		92		87
				39		93		97		93
				40		98		104		98
				41		105		110		105
				42		111		118		111
				43		119		125		119
				44		126		133		126
				45		134		142		134
				46		143		149		143
				47		150		161		152
				48		162		171		162
				49		172		181		172
				50		182		193		183
				51		194		205		195
				52		206		218		207
				53		219		229		220
				54		230		237		234
				55		238		241		249
				56		242		244		265
				57		245		247		282
				58		248		249		300
				59		250		251		316
				60		252		253		333
				61		254		255		350
				>;

			/* Lux table mapping for Smart dimming*/
			samsung,panel-smart-dimming-lux-table = <
				5    6	 7  8   9
				10  11  12 13  14
				15  16  17 19  20
				21  22	24 25  27
				29  30	32 34  37
				39  41	44 47  50
				53  56	60 64  68
				72  77  82 87  93
				98  105	111 119 126
				134 143	152 162 172
				183 195	207 220 234
				249 265	282 300
				>;
	};
};
